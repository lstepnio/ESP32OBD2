## firmware/gauge/main/Kconfig.projbuild
```kconfig
menu "eGauge configuration"

config EGAUGE_JEEP_IDLE_PARKED_TEST
    bool "Enable owner-supervised parked idle tests for the captured Jeep ECM"
    default n
    help
        Temporary Air up/Winch qualification only. Requires exact primary ECM
        calibration/CVN, fresh zero speed/running RPM, local gauge confirmation
        of Park and parking brake, coolant protection and a five-minute ceiling.
        Missing coolant retains the existing one-minute fallback. Phone Start
        remains disabled. Brake actions require their independent owner-test
        switch. Public
        capabilities remain disabled. Never use for driving.

config EGAUGE_JEEP_BRAKE_ACTIONS_OWNER_TEST
    bool "Enable owner-supervised brake actions for the captured Jeep"
    default n
    help
        Development-only ABS/TCS and Burnout candidate for the matched captured
        Jeep. Requires the runtime identity and safety checks plus physical gauge
        Start and manual brake-state confirmation. Manual confirmation does not
        establish automatic brake-state sensing or controller qualification.
        Independent of parked idle tests. Public BLE capabilities stay disabled.

config EGAUGE_OBD_TRACE
    bool "Record bounded OBD transport traces over USB serial"
    default n
    help
        Development capture only. Logs raw adapter commands and response
        fragments with monotonic timestamps, source and generation. Uses a
        bounded queue and reports dropped events. Keep raw recordings private.
        Does not enable any public BLE capability or change vehicle requests.

config EGAUGE_DISPLAY_SETTINGS_ENABLED
    bool "Advertise authenticated display settings"
    default n
    help
        Enables the public display settings capability after a live gauge and
        phone check confirms read, save, rotation, brightness, and persistence.

config EGAUGE_WIFI_BULK_ENABLED
    bool "Advertise experimental authenticated Wi-Fi bulk transfer"
    default n
    help
        Enables the owner-only temporary SoftAP negotiation commands and
        advertises experimental-softap-aead-v2. Keep disabled until the exact
        firmware and Android build complete a live encrypted transfer.

config EGAUGE_DISPLAY_CALIBRATION
    bool "Boot into the physical display calibration sequence"
    default n
    help
        Replaces the gauge runtime with touch-cycled panel test patterns for
        bench characterization. This mode does not start BLE or OBD tasks and
        must remain disabled in release firmware.

config EGAUGE_UI_PERFORMANCE_LOG
    bool "Log touch-to-render timing and LVGL stack headroom"
    default n
    help
        Bench-only timing summaries every 30 seconds after touches. Measures
        LVGL click dispatch through the next render submission, not physical
        contact or final panel scanout. Does not generate touches or car data.

config EGAUGE_ECM_ADAPTER_MAC
    string "ECM BLE adapter MAC address (blank discovers first compatible adapter)"
    default ""
    help
        Six octets separated by colons. The adapter must advertise service 18F0.
        Configure this for deterministic source binding.

endmenu

config EGAUGE_DTC_CLEAR_ENABLED
    bool "Enable qualified addressed ECM emissions clearing"
    default n
    help
        Development qualification switch. Never enable for an unqualified vehicle
        or JSS transmission controller. Reading faults does not qualify clearing.

config EGAUGE_AUTO_ORIENTATION_QUALIFIED
    bool "Advertise physically qualified reference-board Auto orientation"
    depends on EGAUGE_AUTO_ORIENTATION_PROBE_ENABLED
    default n
    help
        Keep disabled until mapping v1, display/touch alignment, motion stability,
        shared-I2C contention, pairing, alerts, updates and cycling are physically
        qualified. Identity/probe success and offline tests do not qualify hardware.

config EGAUGE_AUTO_ORIENTATION_PROBE_ENABLED
    bool "Run offline-qualified candidate orientation sensor worker"
    default n
    help
        Starts one low-priority worker with a 2048-byte internal stack and no
        queue. Reads the existing shared touch I2C bus at 10Hz. Driver waits are
        isolated from the rendering/control owner. Does not qualify Auto or
        enable its capability by itself. Keep disabled in normal release images.

config EGAUGE_AUTO_ORIENTATION_CANDIDATE
    bool "Owner-supervised Auto orientation qualification candidate"
    depends on EGAUGE_AUTO_ORIENTATION_PROBE_ENABLED && !EGAUGE_AUTO_ORIENTATION_QUALIFIED
    default n
    help
        Explicit development-only build for physical orientation qualification.
        Allows the protected Auto choice only after live IMU health is established.
        Does not mark the board physically qualified or enable public capabilities.
        Keep disabled in ordinary images; use the signed candidate release path.
```
